## dts/bindings/usp/semtech,lr2021.yaml
```yaml
description: Semtech LR2021 LoRa radio module

compatible: "semtech,lr2021"

include: semtech,lr20xx-common.yaml
```

## dts/bindings/usp/semtech,lr20xx-common.yaml
```yaml
description: Semtech LR20XX LoRa radio module

include: spi-device.yaml

properties:
  reset-gpios:
    type: phandle-array
    required: true
  busy-gpios:
    type: phandle-array
    required: true
  reg-mode:
    type: int
    required: true
  hf-clk-out-scaling:
    type: int
  tcxo-voltage:
    type: int
    required: true
  tcxo-wakeup-time:
    type: int
    required: true
  lf-clk:
    type: int
    required: true
  pa-ramp-time:
    type: int
  rx-boost-cfg:
    type: int
  tx-power-offset:
    type: int
  tx-power-cfg-lf:
    type: array
    required: true
  tx-power-cfg-hf:
    type: array
    required: true
  tx-dbm-to-ua-reg-mode-dcdc-lf-vreg:
    type: array
    required: true
  tx-dbm-to-ua-reg-mode-ldo-lf-vreg:
    type: array
    required: true
  tx-dbm-to-ua-reg-mode-dcdc-hf-vreg:
    type: array
    required: true
  rx-bw-to-ua-reg-mode-dcdc-lf-vreg:
    type: array
    required: true
  rx-bw-to-ua-reg-mode-dcdc-hf-vreg:
    type: array
    required: true
  rx-bw-to-ua-reg-mode-dcdc-lf-vreg-boosted:
    type: array
    required: true
  rx-bw-to-ua-reg-mode-dcdc-hf-vreg-boosted:
    type: array
    required: true
  rx-bw-to-ua-reg-mode-ldo-lf-vreg:
    type: array
    required: true
  rx-bw-to-ua-reg-mode-ldo-hf-vreg:
    type: array
    required: true
  rx-bw-to-ua-reg-mode-ldo-lf-vreg-boosted:
    type: array
    required: true
  rx-bw-to-ua-reg-mode-ldo-hf-vreg-boosted:
    type: array
    required: true
  calibration-freqs:
    type: array
    required: true
```

## dts/bindings/usp/semtech,lr20xx-dios.yaml
```yaml
description: Semtech LR20XX DIO configuration

compatible: "semtech,lr20xx-dios"

include: base.yaml

properties:
  "#address-cells":
    const: 1
  "#size-cells":
    const: 0

child-binding:
  properties:
    reg:
      type: int
      required: true
    function:
      type: int
      required: true
    sleep-drive:
      type: int
    irq-mask:
      type: int
    dio-gpios:
      type: phandle-array
    rf-sw:
      type: int
```

## rf_certification/Kconfig
```kconfig
# Copyright (c) 2026
# SPDX-License-Identifier: Apache-2.0

config ZEPHYR_LORA_BASICS_MODEM_MODULE
	bool
	default y

menu "Zephyr Kernel"
source "Kconfig.zephyr"
endmenu
```
